## package/ip2uart/Config.in
```kconfig
config BR2_PACKAGE_IP2UART
	bool "ip2uart"
	help
	  ip2uart - small IP-to-UART bridge utility.

	  Installs:
	    - /usr/sbin/ip2uart
	    - /etc/ip2uart.conf
	    - SysV init script: /etc/init.d/S96ip2uart

	  https://github.com/snokvist/ip2uart
```

## package/wfb-bins-only/Config.in
```kconfig
config BR2_PACKAGE_WFB_BINS_ONLY
	bool "wfb-bins-only"
	select BR2_PACKAGE_LIBPCAP
	select BR2_PACKAGE_LIBSODIUM
	select BR2_PACKAGE_LIBEVENT
	help
	  Long-range packet radio link based on raw WiFi radio.
	  https://github.com/svpcom/wfb-ng
```
