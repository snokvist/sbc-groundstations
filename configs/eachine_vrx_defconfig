## configs/eachine_vrx_defconfig
```kconfig
BR2_aarch64=y
BR2_cortex_a55=y
BR2_TOOLCHAIN_EXTERNAL=y
BR2_PACKAGE_OVERRIDE_FILE="${BR2_EXTERNAL_OPENIPC_SBC_GS_PATH}/board/radxa/zero3/waybeam-local.mk"
BR2_TARGET_GENERIC_HOSTNAME="Waybeam-Eachine"
BR2_TARGET_GENERIC_ISSUE="Waybeam"
BR2_ROOTFS_DEVICE_CREATION_DYNAMIC_EUDEV=y
BR2_TARGET_GENERIC_ROOT_PASSWD="12345"
# BR2_TARGET_GENERIC_REMOUNT_ROOTFS_RW is not set
BR2_ENABLE_LOCALE_WHITELIST="C en_US en_US.UTF-8"
BR2_GENERATE_LOCALE="C.UTF-8 en_US.UTF-8"
BR2_ROOTFS_OVERLAY="${BR2_EXTERNAL_OPENIPC_SBC_GS_PATH}/board/common/overlay ${BR2_EXTERNAL_OPENIPC_SBC_GS_PATH}/board/radxa/zero3/overlay ${BR2_EXTERNAL_OPENIPC_SBC_GS_PATH}/board/local/overlay"
BR2_ROOTFS_POST_BUILD_SCRIPT="${BR2_EXTERNAL_OPENIPC_SBC_GS_PATH}/board/common/post-build-script.sh"
BR2_ROOTFS_POST_IMAGE_SCRIPT="support/scripts/genimage.sh"
BR2_ROOTFS_POST_SCRIPT_ARGS="-c ${BR2_EXTERNAL}/board/common/genimage.cfg"
BR2_LINUX_KERNEL=y
BR2_LINUX_KERNEL_CUSTOM_TARBALL=y
BR2_LINUX_KERNEL_CUSTOM_TARBALL_LOCATION="$(call github,radxa,kernel,8b0634cfd2bc551f6c0641f30df9cb03f0bd62f0)/linux-8b0634cfd2bc551f6c0641f30df9cb03f0bd62f0.tar.gz"
BR2_LINUX_KERNEL_PATCH="${BR2_EXTERNAL_OPENIPC_SBC_GS_PATH}/board/radxa/zero3/linux-patches"
BR2_LINUX_KERNEL_USE_DEFCONFIG=y
BR2_LINUX_KERNEL_DEFCONFIG="rockchip_linux"
BR2_LINUX_KERNEL_CONFIG_FRAGMENT_FILES="${BR2_EXTERNAL_OPENIPC_SBC_GS_PATH}/board/radxa/zero3/linux-fragment/radxa-bsp-0001-common-kconfig.conf ${BR2_EXTERNAL_OPENIPC_SBC_GS_PATH}/board/radxa/zero3/linux-fragment/radxa-bsp-0002-rockchip-kconfig.conf ${BR2_EXTERNAL_OPENIPC_SBC_GS_PATH}/board/radxa/zero3/linux-fragment/radxa-bsp-0003-rk2410-kconfig.conf ${BR2_EXTERNAL_OPENIPC_SBC_GS_PATH}/board/radxa/zero3/linux-waybeam.fragment"
BR2_LINUX_KERNEL_DTS_SUPPORT=y
BR2_LINUX_KERNEL_INTREE_DTS_NAME="rockchip/rk3566-radxa-zero-3e rockchip/rk3566-radxa-zero-3w-aic8800ds2 rockchip/rk3566-radxa-zero-3w-ap6212"
BR2_LINUX_KERNEL_CUSTOM_DTS_DIR="${BR2_EXTERNAL_OPENIPC_SBC_GS_PATH}/board/radxa/zero3/dts"
BR2_LINUX_KERNEL_DTB_KEEP_DIRNAME=y
BR2_LINUX_KERNEL_DTB_OVERLAY_SUPPORT=y
BR2_LINUX_KERNEL_INSTALL_TARGET=y
BR2_PACKAGE_BUSYBOX_CONFIG="${BR2_EXTERNAL}/package/busybox/busybox.config"
BR2_PACKAGE_BUSYBOX_SHOW_OTHERS=y
BR2_JLEVEL=0
BR2_PER_PACKAGE_DIRECTORIES=y

## GSTREAMER
BR2_PACKAGE_GSTREAMER1=y
BR2_PACKAGE_GST1_PLUGINS_BASE_PLUGIN_APP=y
BR2_PACKAGE_GST1_PLUGINS_GOOD=y
BR2_PACKAGE_GST1_PLUGINS_GOOD_PLUGIN_MATROSKA=y
BR2_PACKAGE_GST1_PLUGINS_GOOD_PLUGIN_RTP=y
BR2_PACKAGE_GST1_PLUGINS_GOOD_PLUGIN_UDP=y
BR2_PACKAGE_GST1_PLUGINS_BAD=y
BR2_PACKAGE_GST1_PLUGINS_BAD_PLUGIN_VIDEOPARSERS=y
BR2_PACKAGE_GST1_PLUGINS_UGLY=y
BR2_PACKAGE_GST1_PLUGINS_BASE=y
BR2_PACKAGE_GST1_PLUGINS_GOOD_PLUGIN_RTPMANAGER=y
BR2_PACKAGE_GST1_PLUGINS_BASE_PLUGIN_ALSA=y
BR2_PACKAGE_GST1_PLUGINS_BASE_PLUGIN_AUDIOCONVERT=y
BR2_PACKAGE_GST1_PLUGINS_BASE_PLUGIN_AUDIORESAMPLE=y
BR2_PACKAGE_GST1_PLUGINS_BAD_PLUGIN_OPUS=y
BR2_PACKAGE_GST1_PLUGINS_BASE_PLUGIN_OPUS=y
BR2_PACKAGE_GST1_PLUGINS_BAD_PLUGIN_VOAACENC=y
BR2_PACKAGE_GST1_PLUGINS_GOOD_PLUGIN_AUDIOPARSERS=y
##

BR2_PACKAGE_XZ=y
BR2_PACKAGE_GIT=y
BR2_PACKAGE_JQ=y
BR2_PACKAGE_DOSFSTOOLS=y
BR2_PACKAGE_DOSFSTOOLS_FATLABEL=y
BR2_PACKAGE_DOSFSTOOLS_FSCK_FAT=y
BR2_PACKAGE_DOSFSTOOLS_MKFS_FAT=y
BR2_PACKAGE_E2FSPROGS=y
BR2_PACKAGE_E2FSPROGS_RESIZE2FS=y
BR2_PACKAGE_FBV=y
BR2_PACKAGE_LINUX_FIRMWARE=y
BR2_PACKAGE_LINUX_FIRMWARE_RTL_815X=y
BR2_PACKAGE_PARTED=y
BR2_PACKAGE_ROCKCHIP_RKBIN=y
BR2_PACKAGE_ROCKCHIP_RKBIN_TPL_FILENAME="bin/rk35/rk3566_ddr_1056MHz_v1.23.bin"
BR2_PACKAGE_ROCKCHIP_RKBIN_BL31_FILENAME="bin/rk35/rk3568_bl31_v1.44.elf"
BR2_PACKAGE_UBOOT_TOOLS=y
BR2_PACKAGE_PYTHON3=y
BR2_PACKAGE_PYTHON3_BZIP2=y
BR2_PACKAGE_PYTHON3_CURSES=y
BR2_PACKAGE_PYTHON_BABEL=y
BR2_PACKAGE_PYTHON_FLASK=y
BR2_PACKAGE_PYTHON_MSGPACK=y
BR2_PACKAGE_PYTHON_PYROUTE2=y
BR2_PACKAGE_PYTHON_PYYAML=y
BR2_PACKAGE_PYTHON_SERIAL=y
BR2_PACKAGE_PYTHON_TWISTED=y
BR2_PACKAGE_CA_CERTIFICATES=y
BR2_PACKAGE_LIBDRM=y
BR2_PACKAGE_LIBDRM_INSTALL_TESTS=y
BR2_PACKAGE_LIBGPIOD=y
BR2_PACKAGE_LIBGPIOD_TOOLS=y
BR2_PACKAGE_CJSON=y
BR2_PACKAGE_JSON_FOR_MODERN_CPP=y
BR2_PACKAGE_YAML_CPP=y
BR2_PACKAGE_SPDLOG=y
BR2_PACKAGE_LIBCURL=y
BR2_PACKAGE_LIBCURL_CURL=y
BR2_PACKAGE_LIBCAP=y
BR2_PACKAGE_MSGPACK=y
BR2_PACKAGE_NCURSES_WCHAR=y
BR2_PACKAGE_READLINE=y
BR2_PACKAGE_DROPBEAR=y
BR2_PACKAGE_IPROUTE2=y
BR2_PACKAGE_IW=y
BR2_PACKAGE_NETCAT=y
BR2_PACKAGE_NTP=y
BR2_PACKAGE_OPENSSH=y
BR2_PACKAGE_SOCAT=y
BR2_PACKAGE_SSHPASS=y
BR2_PACKAGE_WPA_SUPPLICANT=y
BR2_PACKAGE_WPA_SUPPLICANT_AP_SUPPORT=y
BR2_PACKAGE_WPA_SUPPLICANT_OVERRIDES=y
BR2_PACKAGE_FILE=y
BR2_PACKAGE_COREUTILS=y
BR2_PACKAGE_HTOP=y
BR2_PACKAGE_KMOD_TOOLS=y
BR2_PACKAGE_UTIL_LINUX_AGETTY=y
BR2_TARGET_ROOTFS_SQUASHFS=y
BR2_TARGET_ROOTFS_SQUASHFS4_ZSTD=y
# BR2_TARGET_ROOTFS_TAR is not set
BR2_TARGET_UBOOT=y
BR2_TARGET_UBOOT_PATCH="${BR2_EXTERNAL_OPENIPC_SBC_GS_PATH}/board/radxa/zero3/uboot-patches"
BR2_TARGET_UBOOT_BOARD_DEFCONFIG=y
BR2_TARGET_UBOOT_BOARD_DEFCONFIG="radxa-zero-3-rk3566"
BR2_TARGET_UBOOT_CONFIG_FRAGMENT_FILES="${BR2_EXTERNAL_OPENIPC_SBC_GS_PATH}/board/radxa/zero3/uboot.fragment"
BR2_TARGET_UBOOT_NEEDS_DTC=y
BR2_TARGET_UBOOT_NEEDS_PYLIBFDT=y
BR2_TARGET_UBOOT_NEEDS_PYELFTOOLS=y
BR2_TARGET_UBOOT_NEEDS_GNUTLS=y
BR2_TARGET_UBOOT_NEEDS_ROCKCHIP_RKBIN=y
BR2_PACKAGE_HOST_E2FSPROGS=y
BR2_PACKAGE_HOST_GENIMAGE=y
BR2_PACKAGE_HOST_KMOD_XZ=y
BR2_PACKAGE_HOST_SWIG=y
BR2_PACKAGE_HOST_RKDEVELOPTOOL=y
BR2_PACKAGE_YQ=y
BR2_PACKAGE_DRM_INFO=y
## Eachine VRX boot-hold buttons (verified on factory unit 192.168.2.170).
## Panel buttons resolve by GPIO line name PIN_<n>; hold-at-boot convention is
## Left=gadget, Right=factory-reset. Ruby layout: left=PIN_13, right=PIN_11.
BR2_BOARD_GPIO_CONFIG_PIN_NAME=y
BR2_FACTORY_RESET_GPIO_PIN_NAME="PIN_11"
BR2_GADGET_MODE_GPIO_PIN_NAME="PIN_13"
BR2_PACKAGE_LRZSZ=y

## NETWORK CARDS
BR2_PACKAGE_RTL88X2CU=y
BR2_PACKAGE_RTL88X2EU=y
BR2_PACKAGE_LINUX_FIRMWARE_MEDIATEK_MT76X2E=y
BR2_PACKAGE_AIC8800=y
##

## Extras
BR2_PACKAGE_USB_MODESWITCH=y
BR2_PACKAGE_USB_MODESWITCH_DATA=y
BR2_PACKAGE_USBUTILS=y
BR2_PACKAGE_WIRELESS_REGDB=y
BR2_PACKAGE_HOSTAPD=y
BR2_PACKAGE_HOSTAPD_ACS=y
BR2_PACKAGE_IPROUTE2_TC=y
BR2_PACKAGE_IPROUTE2_IP=y
BR2_PACKAGE_IPTABLES=y
BR2_PACKAGE_ALSA_LIB=y
BR2_PACKAGE_ALSA_PLUGINS=y
BR2_PACKAGE_ALSA_FIRMWARE=y
BR2_PACKAGE_ALSA_UTILS=y
BR2_PACKAGE_ALSA_UTILS_ALSACONF=y
BR2_PACKAGE_ALSA_UTILS_ACONNECT=y
BR2_PACKAGE_ALSA_UTILS_ALSALOOP=y
BR2_PACKAGE_ALSA_UTILS_ALSAUCM=y
BR2_PACKAGE_ALSA_UTILS_ALSATPLG=y
BR2_PACKAGE_ALSA_UTILS_AMIDI=y
BR2_PACKAGE_ALSA_UTILS_AMIXER=y
BR2_PACKAGE_ALSA_UTILS_APLAY=y
BR2_PACKAGE_ALSA_UTILS_APLAYMIDI=y
BR2_PACKAGE_ALSA_UTILS_ARECORDMIDI=y
BR2_PACKAGE_ALSA_UTILS_ASEQDUMP=y
BR2_PACKAGE_ALSA_UTILS_ASEQNET=y
BR2_PACKAGE_ALSA_UTILS_BAT=y
BR2_PACKAGE_ALSA_UTILS_IECSET=y
BR2_PACKAGE_ALSA_UTILS_SPEAKER_TEST=y
BR2_PACKAGE_EUDEV=y
BR2_PACKAGE_ETHTOOL=y
BR2_PACKAGE_SDL2=y
BR2_PACKAGE_LIBUSB=y
BR2_PACKAGE_DHCP=y
BR2_PACKAGE_DHCP_SERVER=y
##

## Debugging: network and streams
BR2_PACKAGE_STRACE=y
BR2_PACKAGE_TCPDUMP=y
BR2_PACKAGE_IPERF3=y
BR2_PACKAGE_IFTOP=y
BR2_PACKAGE_NETHOGS=y
BR2_PACKAGE_NLOAD=y
##

## Debugging: serial/UART
BR2_PACKAGE_PICOCOM=y
##

## Debugging: video/display
BR2_PACKAGE_V4L_UTILS=y
BR2_PACKAGE_KMSCUBE=y
BR2_PACKAGE_FFMPEG=y
##

## Debugging: input devices
BR2_PACKAGE_EVTEST=y
##

## Debugging: hardware interfaces
BR2_PACKAGE_I2C_TOOLS=y
# devmem2 removed in Buildroot 2025.08 — use busybox devmem instead
##

## Debugging: system diagnostics
BR2_PACKAGE_SYSSTAT=y
BR2_PACKAGE_LSOF=y
BR2_PACKAGE_WATCHDOG=y
##

## Developer tools
BR2_PACKAGE_TMUX=y
BR2_PACKAGE_RSYNC=y
BR2_PACKAGE_ZSTD=y
##

## GPU/Display
BR2_PACKAGE_MALI_DRIVER_CUSTOM=y
BR2_PACKAGE_LIBRGA=y
BR2_PACKAGE_MESA3D=y
BR2_PACKAGE_MESA3D_LLVM=y
BR2_PACKAGE_MESA3D_GALLIUM_DRIVER_PANFROST=y
BR2_PACKAGE_MESA3D_OPENGL_EGL=y
BR2_PACKAGE_MESA3D_OPENGL_ES=y
##

## Waybeam packages
BR2_PACKAGE_WAYBEAM_HUB=y
BR2_PACKAGE_RADXA_ZERO3_GAMMA=y
BR2_PACKAGE_WAYBEAM_LINK=y
##
```

## package/autod/Config.in
```kconfig
config BR2_PACKAGE_AUTOD
	bool "autod"
	help
	  autod - small C daemon (includes civetweb/parson) with a VRX web UI.

	  Installs:
	    - /usr/bin/autod
	    - /etc/autod/autod.conf
	    - /usr/share/autod/vrx (UI + assets + exec-handler)

	  Provides:
	    - SysV init script: /etc/init.d/S99autod
	    - systemd unit: /usr/lib/systemd/system/autod.service (if enabled)

	  https://github.com/snokvist/autod
```

## package/joystick2crsf/Config.in
```kconfig
config BR2_PACKAGE_JOYSTICK2CRSF
	bool "joystick2crsf"
	select BR2_PACKAGE_SDL2
	help
	  joystick2crsf - read joystick input (SDL2) and output CRSF frames.

	  Installs:
	    - /usr/bin/joystick2crsf
	    - /etc/joystick2crsf.conf
	    - SysV init script: /etc/init.d/S96joystick2crsf

	  https://github.com/snokvist/joystick2crsf
```

## package/panel-generic-dsi/Config.in
```kconfig
config BR2_PACKAGE_PANEL_GENERIC_DSI
	bool "panel-generic-dsi"
	depends on BR2_LINUX_KERNEL
	help
	  ROCKNIX generic MIPI DSI panel driver.
	  Reads panel configuration (timing, init sequence) from
	  device tree panel_description property.

	  Used by the Powkiddy RGB20Pro 1024x768 display.

	  https://github.com/ROCKNIX
```

## package/pixelpilot_mini_rk/Config.in
```kconfig
config BR2_PACKAGE_PIXELPILOT_MINI_RK
	bool "pixelpilot_mini_rk"
	select BR2_PACKAGE_LIBDRM
	select BR2_PACKAGE_EUDEV
	select BR2_PACKAGE_GSTREAMER1
	select BR2_PACKAGE_GST1_PLUGINS_BASE
	help
	  PixelPilot Mini (RK) - lightweight GStreamer/DRM/Mpp based video +
	  OSD/overlay application for Rockchip targets.

	  Installs:
	    - /usr/bin/pixelpilot_mini_rk
	    - /etc/pixelpilot_mini.ini
	    - /usr/share/pixelpilot_mini_rk/spinner_ai_1080p30.h265
	    - SysV init script: /etc/init.d/S99pixelpilot_mini_rk

	  https://github.com/snokvist/pixelpilot_mini_rk
```

## package/radxa-zero3-gamma/Config.in
```kconfig
config BR2_PACKAGE_RADXA_ZERO3_GAMMA
	bool "radxa-zero3-gamma"
	select BR2_PACKAGE_LIBDRM
	help
	  gamma: small command-line helper for Linux DRM systems that loads a
	  custom gamma LUT into a display controller (CRTC).

	  Installs:
	    /usr/bin/gamma

	  Note: the upstream repository does not currently declare a license.

if BR2_PACKAGE_RADXA_ZERO3_GAMMA

config BR2_PACKAGE_RADXA_ZERO3_GAMMA_DEFAULT_CRTC
	int "Default CRTC ID"
	default 88
	help
	  Default CRTC ID compiled into the binary (DEFAULT_CRTC).

endif
```

## package/rgb20pro-linux-patches/Config.in
```kconfig
config BR2_PACKAGE_RGB20PRO_LINUX_PATCHES
	bool "rgb20pro-linux-patches"
	depends on BR2_LINUX_KERNEL
	depends on BR2_aarch64
	help
	  Apply the Rocknix Powkiddy RGB20 Pro Linux patch set and copy
	  required source files (generic DSI panel + RK2023 DTSI) into
	  the kernel source tree.
	  This package is intentionally separate from linux-patcher so
	  RGB20 Pro support can be enabled/disabled independently.

comment "rgb20pro-linux-patches needs aarch64 + Linux kernel"
	depends on !BR2_LINUX_KERNEL || !BR2_aarch64
```

## package/rocknix-joypad-openipc/Config.in
```kconfig
config BR2_PACKAGE_ROCKNIX_JOYPAD_OPENIPC
	bool "rocknix-joypad-openipc"
	depends on BR2_LINUX_KERNEL
	depends on BR2_aarch64
	select BR2_PACKAGE_RGB20PRO_LINUX_PATCHES
	help
	  Build the Rocknix joypad kernel modules (rocknix-joypad and
	  rocknix-singleadc-joypad) from local sources.

	  Intended for RK3566 handheld input support (e.g. Powkiddy RGB20 Pro).

comment "rocknix-joypad-openipc needs aarch64 + Linux kernel"
	depends on !BR2_LINUX_KERNEL || !BR2_aarch64
```

## package/rocknix-joypad/Config.in
```kconfig
config BR2_PACKAGE_ROCKNIX_JOYPAD
	bool "rocknix-joypad"
	depends on BR2_LINUX_KERNEL
	help
	  ROCKNIX singleadc joypad driver for RK3566 handheld devices.
	  Reads analog sticks via a single SARADC channel with GPIO-based
	  analog multiplexer, and digital buttons via GPIO.
	  Supports PWM-based rumble motor.

	  Used by the Powkiddy RGB20Pro, RK2023, and similar devices.

	  https://github.com/ROCKNIX/rocknix-joypad
```

## package/rtl8821cs/Config.in
```kconfig
config BR2_PACKAGE_RTL8821CS
	bool "rtl8821cs"
	depends on BR2_LINUX_KERNEL
	help
	  Realtek RTL8821CS SDIO WiFi driver.
	  Used by the Powkiddy RGB20Pro and similar RK3566 handhelds.

	  https://github.com/lwfinger/rtl8821cs
```

## package/rtl88x2cu/Config.in
```kconfig
config BR2_PACKAGE_RTL88X2CU
	bool "rtl88x2cu"
	help
		Linux Driver for WiFi Adapters based on RTL8812CU/RTL8822CU chipsets
		with Cooperative RX Diversity (multi-adapter frame-level diversity).
		Fork: https://github.com/snokvist/rtl88x2cu-20230728
```

## package/waybeam-hub/Config.in
```kconfig
config BR2_PACKAGE_WAYBEAM_HUB
	bool "waybeam-hub (ground station)"
	select BR2_PACKAGE_ROCKCHIP_MPP
	select BR2_PACKAGE_GSTREAMER1
	select BR2_PACKAGE_GST1_PLUGINS_BASE
	select BR2_PACKAGE_LIBDRM
	select BR2_PACKAGE_EUDEV
	select BR2_PACKAGE_LIBGPIOD
	select BR2_PACKAGE_CJSON
	select BR2_PACKAGE_LIBCURL
	select BR2_PACKAGE_LIBPNG
	select BR2_PACKAGE_LIBRGA
	help
	  Waybeam hub ground station daemon. Provides integrated video decode
	  (Rockchip MPP), OSD overlay, joystick input, telemetry, WebUI, and
	  menu system.

	  When Mesa3D (EGL/GLES2/GBM) is enabled, the optional GPU
	  color-corrected DVR recording pipeline is compiled in.
```

## package/waybeam-link/Config.in
```kconfig
config BR2_PACKAGE_WAYBEAM_LINK
	bool "waybeam-link (in-process radio link for waybeam-hub)"
	depends on BR2_TOOLCHAIN_GCC_AT_LEAST_11
	depends on BR2_INSTALL_LIBSTDCPP
	depends on BR2_TOOLCHAIN_HAS_THREADS
	help
	  waybeam-link ground RX: a best-effort, latency-first broadcast
	  video + telemetry link over monitor/injection WiFi
	  (RTL8812AU/CU/EU) with per-adapter receive diversity, opt-in
	  importance-gated ARQ, an adaptive per-MCS rate/power layer, and a
	  coordinated follow-me channel switch. Built on the vendored OpenIPC
	  devourer userspace radio stack (static libusb, no system dep).

	  Replaces the wfb-ng ground link.

	  Selecting this does NOT install a daemon. The link runs
	  in-process inside waybeam-hub (mod_wblink), so what this package
	  contributes to the image is a config under /etc/waybeam-link, and
	  what it contributes to the build is libwblink_{core,io,node}.a
	  plus the vendored devourer/libusb. It is REQUIRED by
	  BR2_PACKAGE_WAYBEAM_HUB — a hub built without it is a build
	  error, not a smaller image.

comment "waybeam-link needs a gcc >= 11, C++ and threads toolchain"
	depends on !BR2_TOOLCHAIN_GCC_AT_LEAST_11 || \
		!BR2_INSTALL_LIBSTDCPP || !BR2_TOOLCHAIN_HAS_THREADS
```

## package/wfb_supervisor/Config.in
```kconfig
config BR2_PACKAGE_WFB_SUPERVISOR
	bool "wfb_supervisor"
	help
	  Minimal supervisor for WFB workloads. Builds a small C binary and
	  installs helper scripts plus default config at /etc/wfb.conf.
```
